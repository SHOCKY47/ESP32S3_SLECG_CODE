## sdkconfig.defaults
```kconfig
CONFIG_IDF_TARGET="esp32s3"
CONFIG_BT_ENABLED=y
# BLE 4.2 legacy adv API (esp_ble_gap_start_advertising) — mutually exclusive with BLE 5.0
# CONFIG_BT_BLE_50_FEATURES_SUPPORTED is not set
CONFIG_BT_BLE_42_FEATURES_SUPPORTED=y
CONFIG_FREERTOS_HZ=1000
```
